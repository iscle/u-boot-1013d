// SPDX-License-Identifier: (GPL-2.0+ OR X11)
/*
 * Copyright 2021 Iscle <albertiscle9@gmail.com>
 */

/dts-v1/;
#include "suniv-f1c100s.dtsi"

#include <dt-bindings/gpio/gpio.h>

/ {
	model = "FNIRSI-1013D";
	compatible = "fnirsi,fnirsi-1013d", "allwinner,suniv-f1c100s";

	aliases {
		serial0 = &uart0;
	};

	chosen {
		stdout-path = "serial0:115200n8";
	};
};

&mmc0 {
	broken-cd;
	bus-width = <4>;
	status = "okay";
};
